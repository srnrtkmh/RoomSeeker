//================================================================================================//
//                                                                                                //
// FILE : command.cpp                                                                             //
// MEMO : This library enables you to read command from upper controller                          //
//                                                                                                //
// Update Log                                                                                     //
//   2021/01/03 : Start this project                                                              //
//                                                                                                //
//                                         Copyright (c) 2020 Kyohei Umemoto All Rights reserved. //
//                                                                                                //
//================================================================================================//

#if defined(ARDUINO_ARCH_AVR)

//================================================================================================//
// Include Files                                                                                  //
//================================================================================================//
#include <Arduino.h>
#include "command.h"

//================================================================================================//
// Global Variables                                                                               //
//================================================================================================//

//================================================================================================//
// Wheel velocity command                                                                         //
//   Argument : *str - received character array, ptr - the last pointer of the character array    //
//   Return   : none                                                                              //
//================================================================================================//
void read_wheel_vel_cmd(char *str, uint8_t ptr, long *omega_cmd_x10) {
  if (ptr == 22) {
    if (str[0] == 'v' && str[1] == 'e' && str[2] == 'l') {
      if (str[20] == 'e' && str[21] == 'n' && str[22] == 'd') {
        if (str[3] == ',' && str[7] == ',' && str[13] == ',' && str[19] == ',') {
          if (str[8] == '+')       omega_cmd_x10[0] =   ((int16_t)str[ 9] - 48) * 1000 + ((int16_t)str[10] - 48) * 100 + ((int16_t)str[11] - 48) * 10 + ((int16_t)str[12] - 48);
          else if (str[8] == '-')  omega_cmd_x10[0] = -(((int16_t)str[ 9] - 48) * 1000 + ((int16_t)str[10] - 48) * 100 + ((int16_t)str[11] - 48) * 10 + ((int16_t)str[12] - 48));
          if (str[14] == '+')      omega_cmd_x10[1] =   ((int16_t)str[15] - 48) * 1000 + ((int16_t)str[16] - 48) * 100 + ((int16_t)str[17] - 48) * 10 + ((int16_t)str[18] - 48);
          else if (str[14] == '-') omega_cmd_x10[1] = -(((int16_t)str[15] - 48) * 1000 + ((int16_t)str[16] - 48) * 100 + ((int16_t)str[17] - 48) * 10 + ((int16_t)str[18] - 48));
        }
      }
    }
  }
}

//================================================================================================//
// Voltage command                                                                                //
//================================================================================================//
void read_vol_cmd(char *str, uint8_t ptr, int16_t *vol_cmd) {
  // Future works
  if (ptr == 22) {
    if (str[0] == 'v' && str[1] == 'o' && str[2] == 'l') {
      if (str[20] == 'e' && str[21] == 'n' && str[22] == 'd') {
        if (str[3] == ',' && str[7] == ',' && str[13] == ',' && str[19] == ',') {
          if (str[8] == '+')       vol_cmd[0] =   ((int16_t)str[ 9] - 48) * 1000 + ((int16_t)str[10] - 48) * 100 + ((int16_t)str[11] - 48) * 10 + ((int16_t)str[12] - 48);
          else if (str[8] == '-')  vol_cmd[0] = -(((int16_t)str[ 9] - 48) * 1000 + ((int16_t)str[10] - 48) * 100 + ((int16_t)str[11] - 48) * 10 + ((int16_t)str[12] - 48));
          if (str[14] == '+')      vol_cmd[1] =   ((int16_t)str[15] - 48) * 1000 + ((int16_t)str[16] - 48) * 100 + ((int16_t)str[17] - 48) * 10 + ((int16_t)str[18] - 48);
          else if (str[14] == '-') vol_cmd[1] = -(((int16_t)str[15] - 48) * 1000 + ((int16_t)str[16] - 48) * 100 + ((int16_t)str[17] - 48) * 10 + ((int16_t)str[18] - 48));
        }
      }
    }
  }
}

//================================================================================================//
// Parameter change command No.1                                                                  //
//================================================================================================//
void read_pr1_cmd(char *str, uint8_t ptr) {
  if (ptr == 100) {
    if (str[0] == 'p' && str[1] == 'r' && str[2] == '1') {
      // Future works
    }
  }
}

//================================================================================================//
// Parameter change command No.2                                                                  //
//================================================================================================//
void read_pr2_cmd(char *str, uint8_t ptr) {
  if (ptr == 100) {
    if (str[0] == 'p' && str[1] == 'r' && str[2] == '2') {
      // Future works
    }
  }
}

//================================================================================================//
// Parameter change command No.3                                                                  //
//================================================================================================//
void read_pr3_cmd(char *str, uint8_t ptr) {
  if (ptr == 100) {
    if (str[0] == 'p' && str[1] == 'r' && str[2] == '3') {
      // Future works
    }
  }
}

#endif // ARDUINO_ARCH_AVR
