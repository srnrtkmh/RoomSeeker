//================================================================================================//
//                                                                                                //
// FILE : acceleration.cpp                                                                        //
// MEMO : This library provides acceleration object to control robot                              //
//                                                                                                //
// Update Log                                                                                     //
//   2020/08/11 : Start this project                                                              //
//                                                                                                //
//                                         Copyright (c) 2020 Kyohei Umemoto All Rights reserved. //
//                                                                                                //
//================================================================================================//

//================================================================================================//
// Include Files                                                                                  //
//================================================================================================//
#if defined(ARDUINO_ARCH_AVR)

#include <Arduino.h>
#include "acceleration.h"

//================================================================================================//
// Global Variables                                                                               //
//================================================================================================//

//================================================================================================//
//================================================================================================//
long acceleration::init(long acc_init, long acc_cmd, long acc_time_ms, long sampling_time_ms){
  uint8_t i;
  if (acc_time_ms > sampling_time_ms){
    this->n = 0;
    this->acc_num = acc_time_ms / sampling_time_ms;
    for (i = 0; i < 100; i++){
      acc_table[i] = (acc_cmd - acc_init) / 100 * i + acc_init;
    }
    return(this->acc_num);
  }
  else{
    return(1);
  }
}

//================================================================================================//
//================================================================================================//
long acceleration::get_cmd(long n){
  if(0 <= n && n <= this->acc_num){
    return(this->acc_table[map(n, 0, this->acc_num, 0, 99)]);
  }
  else{
    return(0);
  }
}

//================================================================================================//
//================================================================================================//
void acceleration::clear(void){
  this->n = 0;
}

#endif // ARDUINO_ARCH_AVR
